## drivers/sharp/wifi/broadcom/5.90_1/bcmdhd/Kconfig
```kconfig
config SH_BCMDHD
	tristate "Broadcom 4329/30 wireless cards support"
	depends on MMC
	default n
	---help---
	  This module adds support for wireless adapters based on
	  Broadcom 4329/30 chipset.

	  This driver uses the kernel's wireless extensions subsystem.

	  If you choose to build a module, it'll be called dhd. Say M if
	  unsure.

#config BCMDHD_FW_PATH
#	depends on SH_BCMDHD
#	string "Firmware path"
#	default "/system/etc/firmware/bcm/fw_bcm4330.bin"
#	---help---
#	  Path to the firmware file.

config BCMDHD_NVRAM_PATH
	depends on SH_BCMDHD
	string "NVRAM path"
	default "/system/etc/firmware/bcm/nvram_bcm4330.txt"
	---help---
	  Path to the calibration file.

config BCMDHD_WEXT
	bool "Enable WEXT support"
	depends on SH_BCMDHD && CFG80211 = n
	select WIRELESS_EXT
	select WEXT_PRIV
	help
	  Enables WEXT support
```
